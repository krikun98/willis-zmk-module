## boards/arm/willis/Kconfig.board
```kconfig
# Copyright (c) 2024 The ZMK Contributors
# SPDX-License-Identifier: MIT

config BOARD_WILLIS
    bool "willis"
    depends on SOC_NRF52840_QIAA
```

## boards/arm/willis/Kconfig.defconfig
```kconfig
# Copyright (c) 2024 The ZMK Contributors
# SPDX-License-Identifier: MIT

if BOARD_WILLIS

config ZMK_KEYBOARD_NAME
    default "Willis"

if USB_DEVICE_STACK

config USB_NRFX
    default y

endif # USB_DEVICE_STACK

config BT_CTLR
    default BT

endif # BOARD_WILLIS
```
